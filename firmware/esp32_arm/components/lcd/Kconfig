## firmware/esp32_arm/components/lcd/Kconfig
```kconfig
menu "LCD I2C Configuration"

    config LCD_I2C_SDA_GPIO
        int "I2C data GPIO (HW-221 A1 -> module SDA)"
        range 0 SOC_GPIO_OUT_RANGE_MAX
        default 25
        help
            I2C SDA to the PCF8574 backpack through the HW-221 (TXS0108E) level
            shifter. Default 25, verified on hardware: free next to the robotic arm
            (1/3 PC link, UART0; 14/27 console, UART1; 16/17 servo bus, UART2) and the
            TFT (5, 18, 21, 22, 23), and not a strapping pin. Internal pull-ups stay
            disabled.

    config LCD_I2C_SCL_GPIO
        int "I2C clock GPIO (HW-221 A2 -> module SCL)"
        range 0 SOC_GPIO_OUT_RANGE_MAX
        default 26
        help
            I2C SCL, 100 kHz (PCF8574 maximum). Default 26, chosen for the same
            reasons as SDA. Internal pull-ups stay disabled.

    config LCD_I2C_ADDR
        hex "PCF8574 I2C address (7 bits)"
        range 0x08 0x77
        default 0x27
        help
            0x27 is a PCF8574 with A0-A2 open (verified on the module); a PCF8574A
            answers in 0x38..0x3F. If this address does not answer, lcd_init() scans
            the bus, logs every address found and, if exactly one device answers,
            uses it with a warning (lcd_get_info() reports the address in use).

endmenu
```

## firmware/esp32_arm/components/lcd_ui/Kconfig
```kconfig
menu "LCD UI (lcd_ui) Configuration"

    config LCD_UI_MAX_WIDGETS
        int "Widgets per screen"
        range 4 64
        default 12
        help
            Size of the static widget pool. Every ui_screen_begin() empties it; a
            screen that adds more widgets fails in ui_screen_end() with
            ESP_ERR_NO_MEM. Footer lines count as widgets.

    config LCD_UI_TEXT_MAX
        int "Longest text per widget (characters)"
        range 16 512
        default 64
        help
            Every widget copies its text (ui_text, labels, messages, the typed line)
            into a buffer of this size plus the NUL. Longer texts are cut. The panel
            shows at most 32 characters (16x2) anyway.

endmenu
```

## firmware/esp32_arm/main/Kconfig.projbuild
```kconfig
menu "Robotic Arm Configuration"

    config ARM_PC_UART_BAUD_RATE
        int "PC link baud rate (UART0)"
        range 9600 5000000
        default 115200
        help
            Baud rate of the PC <-> ESP32 protocol over USB (UART0).
            Must match the ros2_control plugin (robotic_arm_interface.cpp).
            UART0 port and pins are fixed by the board's USB chip and are not configurable.

    config ARM_SERVO_UART_BAUD_RATE
        int "Servo bus baud rate (UART2)"
        range 9600 5000000
        default 1000000
        help
            Baud rate of the servo driver bus. Must match the baud rate stored in the
            servos' EEPROM (1000000 for the STS3215, see STServo_Python/calibrate-arm.py).

    config ARM_SERVO_UART_TX_GPIO
        int "Servo bus TX GPIO (UART2)"
        range 0 SOC_GPIO_OUT_RANGE_MAX
        default 17
        help
            GPIO wired to the servo driver's RX line. Avoid strapping pins
            (0, 2, 5, 12, 15) and flash pins (6-11).

    config ARM_SERVO_UART_RX_GPIO
        int "Servo bus RX GPIO (UART2)"
        range 0 SOC_GPIO_IN_RANGE_MAX
        default 16
        help
            GPIO wired to the servo driver's TX line. Avoid strapping pins
            (0, 2, 5, 12, 15) and flash pins (6-11).

    config ARM_SERVO_MOVE_SPEED
        int "Servo max speed (steps/s)"
        range 1 3400
        default 300
        help
            Max speed sent with every goal position (4096 steps = 1 turn; 300 ~= 26 deg/s).
            Caps how fast each servo can follow the targets from the PC: too low and the
            arm lags MoveIt trajectories. 3400 ~= 50 RPM is the STS3215 no-load max.
            Default matches STServo_Python/servo_control_ui.py (slow and safe for bring-up).

    config ARM_SERVO_MOVE_ACC
        int "Servo acceleration (x100 steps/s^2)"
        range 1 254
        default 10
        help
            Acceleration sent with every goal position, in units of 100 steps/s^2
            (10 = 1000 steps/s^2 ~= 88 deg/s^2). Default matches servo_control_ui.py.

    config ARM_CTL_MOVE_SPEED
        int "Panel CTL max speed (steps/s)"
        range 1 3400
        default 300
        help
            Max speed sent with every goal from the local panel (JOINTS screen, CTL mode).
            Separate from ARM_SERVO_MOVE_SPEED so raising the speed of the M frames for
            MoveIt does not speed up the panel. 300 ~= 26 deg/s.

    config ARM_CTL_MOVE_ACC
        int "Panel CTL acceleration (x100 steps/s^2)"
        range 1 254
        default 10
        help
            Acceleration sent with every goal from the local panel, in units of
            100 steps/s^2 (10 ~= 88 deg/s^2). Separate from ARM_SERVO_MOVE_ACC.

endmenu

menu "Pot + button navigation"

    config NAV_BUTTON_GPIO
        int "Button GPIO"
        range 0 39
        default 33
        help
            Pushbutton input: active low, external 10 kOhm pull-up to 3V3 and 100 nF
            across the button (as in pulsador_idf). No internal pull is enabled. Read
            with a level-triggered IRQ plus debounce / long-press timers. Avoid
            the strapping pins (0, 2, 5, 12, 15) and the LCD (25, 26) and pot (34) pins.

    config NAV_BUTTON_DEBOUNCE_MS
        int "Button debounce (ms without changes)"
        range 10 200
        default 30
        help
            One-shot timer started by the button IRQ (which is then masked): when it
            expires the pin is read, the level confirmed and the IRQ re-armed.

    config NAV_LONG_PRESS_MS
        int "Long press (ms): go to HOME"
        range 500 10000
        default 3000
        help
            Holding the button this long goes to HOME from any screen or mode. It
            fires once while the button is still held; the release then gives no
            short press.

    config NAV_POT_STEP_PCT
        int "Pot navigation step (% of travel per item)"
        range 2 50
        default 8
        help
            Relative navigation: every time the pot moves this much from its anchor,
            the cursor moves one item (menu entry, INFO line, joint).

    config NAV_POT_HYST_PCT
        int "Pot navigation reverse hysteresis (%)"
        range 0 10
        default 2
        help
            Extra travel needed to move the cursor back after a move, so ADC noise
            near a step boundary cannot toggle it. Must be smaller than the step.

endmenu
```
